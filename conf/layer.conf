## conf/layer.conf
```bitbake
# We have a conf and classes directory, add to BBPATH
BBPATH .= ":${LAYERDIR}"

# We have recipes-* directories, add to BBFILES
BBFILES += "${LAYERDIR}/recipes-*/*/*.bb \
            ${LAYERDIR}/recipes-*/*/*.bbappend"

BBFILE_COLLECTIONS += "meta-rtl8761-firmware"
BBFILE_PATTERN_meta-rtl8761-firmware = "^${LAYERDIR}/"
BBFILE_PRIORITY_meta-rtl8761-firmware = "6"

LAYERDEPENDS_meta-rtl8761-firmware = "core"
LAYERSERIES_COMPAT_meta-rtl8761-firmware = "kirkstone"
```
